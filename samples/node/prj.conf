## CMakeLists.txt
```
# SPDX-FileCopyrightText: 2026 Embetech sp. z o.o.
# SPDX-License-Identifier: Apache-2.0

cmake_minimum_required(VERSION 3.20.0)

# Adds this repository as a Zephyr module, so the sample builds without a west manifest entry.
cmake_path(SET EMBENET_MODULE_DIR NORMALIZE "${CMAKE_CURRENT_LIST_DIR}/../..")
list(APPEND ZEPHYR_EXTRA_MODULES ${EMBENET_MODULE_DIR})

find_package(Zephyr REQUIRED HINTS $ENV{ZEPHYR_BASE})
project(embenet_node_sample)

target_sources(app PRIVATE src/node.c)

set(COMMON_DIR ${CMAKE_CURRENT_LIST_DIR}/../common)
target_sources(app PRIVATE ${COMMON_DIR}/blinky_service/blinky_io.c ${COMMON_DIR}/blinky_service/blinky_service_common.c
                           ${COMMON_DIR}/blinky_service/blinky_service_node.c ${COMMON_DIR}/time_report/time_report.c
)
target_include_directories(app PRIVATE ${COMMON_DIR} ${COMMON_DIR}/blinky_service ${COMMON_DIR}/time_report)
```

## sample.yaml
```
# SPDX-FileCopyrightText: 2026 Embetech sp. z o.o.
# SPDX-License-Identifier: Apache-2.0

sample:
  name: embeNET Node
  description: Mesh node that joins an embeNET network, reports on network time and links buttons and LEDs across the network
tests:
  sample.embenet.node:
    tags: embenet
    build_only: true
    platform_allow:
      - nrf52840dk/nrf52840
      - nrf52833dk/nrf52833
      - nrf52dk/nrf52832
      - nrf5340dk/nrf5340/cpunet
      - nrf54l15dk/nrf54l15/cpuapp
```

## prj.conf
```kconfig
# SPDX-FileCopyrightText: 2026 Embetech sp. z o.o.
# SPDX-License-Identifier: Apache-2.0

CONFIG_EMBENET=y
CONFIG_EMBENET_NODE=y

# Buttons and LEDs of the blinky service.
CONFIG_GPIO=y

# Log formatting runs on the system workqueue and needs more than the default stack.
CONFIG_SYSTEM_WORKQUEUE_STACK_SIZE=2048

CONFIG_LOG=y
CONFIG_LOG_MODE_DEFERRED=y
CONFIG_LOG_DEFAULT_LEVEL=3
CONFIG_ASSERT=y
CONFIG_LOG_PRINTK=y
CONFIG_LOG_BUFFER_SIZE=2048

CONFIG_USE_SEGGER_RTT=y
CONFIG_STDOUT_CONSOLE=y
CONFIG_THREAD_NAME=y
CONFIG_PRINTK=y
CONFIG_LOG_BACKEND_SHOW_COLOR=n
# main() runs the stack and with it every stack callback.
CONFIG_MAIN_STACK_SIZE=2048
```

## boards/nrf5340dk_nrf5340_cpunet.conf
```kconfig
# SPDX-FileCopyrightText: 2026 Embetech sp. z o.o.
# SPDX-License-Identifier: Apache-2.0

# The network core has no RTC to spare, so the embeNET timer borrows a compare channel of RTC1, the system clock's.
CONFIG_NRF_RTC_TIMER_USER_CHAN_COUNT=1

# On by default for a network core image with logging: it aligns log timestamps with the application core, holding an
# RTC1 channel until the application core answers. The empty application core image never does, so the channel - the
# embeNET timer's - would never be freed.
CONFIG_NRF53_SYNC_RTC=n
```

## boards/nrf52833dk_nrf52833.overlay
```dts
/* This UART is used only by a root node to talk to an external border router; regular nodes do not use it. */
/ {
	aliases {
		embenet-border-router-uart = &uart1;
	};
};

&uart1 {
	status = "okay";
	current-speed = <115200>;
};
```

## boards/nrf52840dk_nrf52840.overlay
```dts
/* The node port opens this UART even though a plain mesh node does not use it - only a root node
 * talks to a border router over it. Left configured so startup stays quiet. */
/ {
	aliases {
		embenet-border-router-uart = &uart1;
	};
};

&uart1 {
	status = "okay";
	current-speed = <115200>;
};
```

## boards/nrf54l15dk_nrf54l15_cpuapp.overlay
```dts
/* See the nRF52 overlay. uart30 is free on the application core; uart20 is the console. */
/ {
	aliases {
		embenet-border-router-uart = &uart30;
	};
};

&uart30 {
	status = "okay";
};
```

## src/node.c
```c
/**
 * @file
 * @brief embeNET Node sample - joins a network, blinks an LED on network time, reports to the border router every
 * second and links the DK's buttons and LEDs with the gateway's.
 */

#include <blinky_service_node.h>
#include <embenet_demo_network.h>
#include <time_report.h>

#include <embenet/node.h>

#include <embenet_port_common/embenet_port_common.h>
#include <zephyr/kernel.h>
#include <zephyr/logging/log.h>

#include <inttypes.h>

LOG_MODULE_REGISTER(main, LOG_LEVEL_INF);

/// @brief Credentials the node joins with. In a product these come from secure settings or a provisioned partition, not from the image.
static EMBENET_NODE_JoinConfig const join_config = {
    .k1 = {.val = {DEMO_K1_BYTE, 0, 0, 0, 0, 0, 0, 0, 0, 0, 0, 0, 0, 0, 0, 0}},
    .psk = {.val = {DEMO_PSK_BYTE, 0, 0, 0, 0, 0, 0, 0, 0, 0, 0, 0, 0, 0, 0, 0}},
};

static void on_joined(EMBENET_PANID pan_id, EMBENET_NODE_QuickJoinCredentials const *quick_join_credentials) {
  ARG_UNUSED(quick_join_credentials);
  LOG_INF("joined network 0x%04" PRIx16, pan_id);
  blinky_service_node_on_joined();
  time_report_on_joined();
}

static void on_left(void) {
  LOG_WRN("left the network");
  blinky_service_node_on_left();
  time_report_on_left();
}

static void on_join_attempt(EMBENET_PANID pan_id, uint8_t const *pan_data, size_t pan_data_size) {
  bool const pan_data_is_c_string = pan_data != NULL && pan_data_size > 0 && pan_data[pan_data_size - 1] == '\0';

  LOG_INF("attempting to join network 0x%04" PRIx16 ", %zu bytes of PAN data: '%s'", pan_id, pan_data_size,
          pan_data_is_c_string ? (char const *)pan_data : "(not a C-string)");
}

static void on_data_on_unregistered_port(uint16_t port) { LOG_WRN("datagram on unregistered port %" PRIu16, port); }

/**
 * @brief Starts the node and its services, then runs the stack until the board is reset.
 * @return 0 if the stack failed to start; otherwise never returns.
 */
int main(void) {
  LOG_INF("Starting embeNET Node sample");
  LOG_INF("Using embeNET Node version: %s", EMBENET_NODE_GetVersionString());

  EMBENET_NODE_EventHandlers const handlers = {
      .onJoined = on_joined,
      .onLeft = on_left,
      .onJoinAttempt = on_join_attempt,
      .onQuickJoinCredentialsObsolete = NULL,
      .onDataOnUnregisteredPort = on_data_on_unregistered_port,
  };

  EMBENET_Result result = EMBENET_NODE_Init(&handlers, EMBENET_NODE_GetConfig_2400_2480Mhz_BLE_PHY());
  if(result != EMBENET_RESULT_OK) {
    LOG_ERR("EMBENET_NODE_Init() failed: %d", (int)result);
    return 0;
  }

  if((0 != blinky_service_node_init(NULL)) || (0 != time_report_init())) {
    return 0;
  }

  LOG_INF("UID %016" PRIx64, EMBENET_NODE_GetUID());

  result = EMBENET_NODE_Join(&join_config);
  if(result != EMBENET_RESULT_OK) {
    LOG_ERR("EMBENET_NODE_Join() failed: %d", (int)result);
    return 0;
  }

  // The stack runs only inside EMBENET_NODE_Proc(). The port gives the semaphore as soon as there is work; the
  // timeout also bounds how long a button press waits.
  for(;;) {
    k_sem_take(EMBENET_PORT_COMMON_GetProcSemaphore(), K_MSEC(5));
    EMBENET_NODE_Proc();
    blinky_service_node_proc();
  }
}
```
