## CMakeLists.txt
```
# SPDX-FileCopyrightText: 2026 Embetech sp. z o.o.
# SPDX-License-Identifier: Apache-2.0

cmake_minimum_required(VERSION 3.20.0)

# Adds this repository as a Zephyr module, so the sample builds without a west manifest entry.
cmake_path(SET EMBENET_MODULE_DIR NORMALIZE "${CMAKE_CURRENT_LIST_DIR}/../..")
list(APPEND ZEPHYR_EXTRA_MODULES ${EMBENET_MODULE_DIR})

find_package(Zephyr REQUIRED HINTS $ENV{ZEPHYR_BASE})
project(embenet_node_ble_sample)

target_sources(app PRIVATE src/node.c)

set(COMMON_DIR ${CMAKE_CURRENT_LIST_DIR}/../common)
target_sources(app PRIVATE ${COMMON_DIR}/blinky_service/blinky_io.c ${COMMON_DIR}/blinky_service/blinky_service_common.c
                           ${COMMON_DIR}/blinky_service/blinky_service_node.c ${COMMON_DIR}/time_report/time_report.c
)
target_include_directories(app PRIVATE ${COMMON_DIR} ${COMMON_DIR}/blinky_service ${COMMON_DIR}/time_report)

# The embeNET middleware and its GATT services.
target_sources(app PRIVATE src/embenet.c src/embenet_ble.c src/embenet_ble_provisioning.c src/embenet_ble_info.c)
```

## Kconfig
```
# SPDX-FileCopyrightText: 2026 Embetech sp. z o.o.
# SPDX-License-Identifier: Apache-2.0

# The name a Bluetooth scanner shows, telling the chips apart. Ahead of Kconfig.zephyr, so that these
# defaults take precedence over Zephyr's own.
config BT_DEVICE_NAME
	default "embeNET nRF54L15" if SOC_NRF54L15
	default "embeNET nRF52840" if SOC_NRF52840
	default "embeNET nRF52833" if SOC_NRF52833
	default "embeNET nRF52832" if SOC_NRF52832
	default "embeNET nRF5340" if SOC_NRF5340_CPUNET
	default "embeNET nRF54" if SOC_SERIES_NRF54L
	default "embeNET nRF52" if SOC_SERIES_NRF52

# Connection parameters the node asks a central for: a long interval (200-400 ms) and a 7 s supervision
# timeout leave most of the radio to the mesh. The timeout must exceed (1 + latency) x max interval x 2,
# or Zephyr never sends the request; src/embenet_ble.c checks this at build time.
config BT_PERIPHERAL_PREF_MIN_INT
	default 160 # x 1.25 ms = 200 ms

config BT_PERIPHERAL_PREF_MAX_INT
	default 320 # x 1.25 ms = 400 ms

config BT_PERIPHERAL_PREF_LATENCY
	default 0

config BT_PERIPHERAL_PREF_TIMEOUT
	default 700 # x 10 ms = 7000 ms

source "Kconfig.zephyr"

# ----- embeNET middleware, src/embenet*.c - see src/README.md -----

menu "embeNET middleware"

config EMBENET_SETTINGS_DEFAULT_K1
	string "Default K1, as 32 hex digits"
	default "11000000000000000000000000000000"
	help
	  The network key the node uses while the setting embenet/k1 has never been stored. Must
	  match every device of the network; this default matches samples/border_router_integrated.

config EMBENET_SETTINGS_DEFAULT_PSK
	string "Default PSK, as 32 hex digits"
	default "33000000000000000000000000000000"
	help
	  The pre-shared key the node uses while the setting embenet/psk has never been stored. The
	  border router's join rule must admit it; this default matches samples/border_router_integrated.

config EMBENET_SETTINGS_DEFAULT_ACTIVE
	bool "Stack active by default"
	default y
	help
	  Whether the stack runs while the setting embenet/active has never been stored.

config EMBENET_MIDDLEWARE_THREAD_STACK_SIZE
	int "Stack size of the embeNET thread, in bytes"
	default 2048
	help
	  The thread runs EMBENET_NODE_Proc() and with it every stack callback, including the
	  application's event callback and its stack tasks.

# The Bluetooth LE peripheral, src/embenet_ble*.c: embeNET Provisioning (K1, PSK, active switch) and embeNET Info (EUI-64,
# stack version, groups, neighbors, parent, radio duty cycle) GATT services.

config EMBENET_BLE_ADV_INTERVAL_MIN_MS
	int "Minimum advertising interval, in milliseconds"
	default 500
	range 20 10240

config EMBENET_BLE_ADV_INTERVAL_MAX_MS
	int "Maximum advertising interval, in milliseconds"
	default 600
	range 20 10240
	help
	  A longer interval leaves more radio time to the mesh at the cost of slower discovery.

config EMBENET_BLE_INFO_MAX_GROUPS
	int "Groups the Info service reports at most"
	default 16

endmenu
```

## Kconfig.sysbuild
```
# SPDX-FileCopyrightText: 2026 Embetech sp. z o.o.
# SPDX-License-Identifier: Apache-2.0

# nRF5340 DK: the node runs on the network core, which only the application core can start. Build the empty application
# core image for that; it also hands the LEDs and buttons over (see sysbuild/empty_app_core.overlay).
config NRF_DEFAULT_EMPTY
	default y if SOC_NRF5340_CPUNET

source "share/sysbuild/Kconfig"
```

## sample.yaml
```
# SPDX-FileCopyrightText: 2026 Embetech sp. z o.o.
# SPDX-License-Identifier: Apache-2.0

sample:
  name: embeNET Node with Bluetooth LE
  description: Mesh node sharing its radio with a Bluetooth LE peripheral
tests:
  sample.embenet.node_ble:
    tags: embenet
    build_only: true
    platform_allow:
      - nrf52840dk/nrf52840
      - nrf52833dk/nrf52833
      - nrf52dk/nrf52832
      - nrf5340dk/nrf5340/cpunet
      - nrf54l15dk/nrf54l15/cpuapp
```

## prj.conf
```kconfig
# SPDX-FileCopyrightText: 2026 Embetech sp. z o.o.
# SPDX-License-Identifier: Apache-2.0

CONFIG_EMBENET=y
CONFIG_EMBENET_NODE=y

# Buttons and LEDs of the blinky service.
CONFIG_GPIO=y

# Log formatting runs on the system workqueue and needs more than the default stack.
CONFIG_SYSTEM_WORKQUEUE_STACK_SIZE=2048

CONFIG_LOG=y
CONFIG_LOG_MODE_DEFERRED=y
CONFIG_LOG_DEFAULT_LEVEL=3
CONFIG_ASSERT=y
CONFIG_LOG_PRINTK=y
CONFIG_LOG_BUFFER_SIZE=2048

CONFIG_USE_SEGGER_RTT=y
CONFIG_STDOUT_CONSOLE=y
CONFIG_THREAD_NAME=y
CONFIG_PRINTK=y
CONFIG_LOG_BACKEND_SHOW_COLOR=n
# main() starts the node and logs its state.
CONFIG_MAIN_STACK_SIZE=2048

# Settings keep K1, PSK and the active switch across resets.
CONFIG_FLASH=y
CONFIG_FLASH_MAP=y
CONFIG_SETTINGS=y
CONFIG_SETTINGS_RUNTIME=y

# Radio sharing between the node and Bluetooth LE.
CONFIG_MPSL=y
CONFIG_MPSL_TIMESLOT_SESSION_COUNT=1
CONFIG_EMBENET_NODE_MULTIPROTOCOL=y

# Bluetooth LE peripheral with the embeNET Provisioning and Info GATT services - see src/README.md.
CONFIG_BT=y
CONFIG_BT_PERIPHERAL=y
CONFIG_BT_RX_STACK_SIZE=2048
```

## boards/nrf52833dk_nrf52833.conf
```kconfig
# SPDX-FileCopyrightText: 2026 Embetech sp. z o.o.
# SPDX-License-Identifier: Apache-2.0

# Settings backend for nRF52 flash.
CONFIG_NVS=y
```

## boards/nrf5340dk_nrf5340_cpunet.conf
```kconfig
# SPDX-FileCopyrightText: 2026 Embetech sp. z o.o.
# SPDX-License-Identifier: Apache-2.0

# Settings live in the network core's storage_partition.
CONFIG_NVS=y

# The network core has no RTC to spare, so the embeNET timer borrows a compare channel of RTC1, the system clock's.
CONFIG_NRF_RTC_TIMER_USER_CHAN_COUNT=1

# On by default for a network core image with logging: it aligns log timestamps with the application core, holding an
# RTC1 channel until the application core answers. The empty application core image never does, so the channel - the
# embeNET timer's - would never be freed.
CONFIG_NRF53_SYNC_RTC=n

# The image has to fit the network core's 256 KB of flash below storage_partition (moved to 0x3e000 by the overlay), next
# to the Bluetooth host and the multirole controller, the only one NCS ships for the network core. Asserts are what gives.
CONFIG_ASSERT=n
```

## boards/nrf54l15dk_nrf54l15_cpuapp.conf
```kconfig
# SPDX-FileCopyrightText: 2026 Embetech sp. z o.o.
# SPDX-License-Identifier: Apache-2.0

# Settings backend for nRF54L RRAM.
CONFIG_ZMS=y
```

## boards/nrf5340dk_nrf5340_cpunet.overlay
```dts
/* SPDX-FileCopyrightText: 2026 Embetech sp. z o.o. */
/* SPDX-License-Identifier: Apache-2.0 */

/*
 * The image - Bluetooth host and controller, MPSL and embeNET - is nearly 240 KB, and without MCUboot it is linked from
 * the start of the network core's flash, over the board's storage_partition at 0x3a000. The settings hold a handful of
 * keys, so storage shrinks to the last four pages of flash, which settings NVS takes as four sectors.
 */
/delete-node/ &storage_partition;

&flash1 {
	partitions {
		storage_partition: partition@3e000 {
			compatible = "zephyr,mapped-partition";
			label = "storage";
			reg = <0x0003e000 0x2000>;
		};
	};
};
```

## boards/nrf54l15dk_nrf54l15_cpuapp.overlay
```dts
/* This UART is used only by a root node to talk to an external border router; regular nodes do not use it. */
/ {
	aliases {
		embenet-border-router-uart = &uart30;
	};
};

&uart30 {
	status = "okay";
};
```

## src/embenet.c
```c
/**
 * @file
 * @license   Apache-2.0
 * @copyright Embetech sp. z o.o.
 * @version   2.0.0
 * @purpose   Runs and wraps the embeNET Node.
 * @brief     Implements the thread-safe embeNET middleware API, see embenet.h.
 *
 * The embeNET thread is the only one that drives the stack's life cycle. It sleeps on the port's semaphore, which the
 * port's interrupts give when the stack has work, and runs EMBENET_NODE_Proc() under the module mutex.
 *
 * The configuration comes from Zephyr settings. The settings handler below only records a changed value; the thread
 * applies it once it has settled, by leaving the network, stopping the stack and starting it again with the new
 * credentials.
 *
 * @note All functions are thread safe.
 */

#include "embenet.h"

#include <embenet/node.h>
#include <embenet/node_diag.h>
#include <embenet_port/eui64.h>
#include <embenet_port_common/embenet_port_common.h>

#include <zephyr/kernel.h>
#include <zephyr/logging/log.h>
#include <zephyr/settings/settings.h>
#include <zephyr/sys/util.h>

#include <errno.h>
#include <inttypes.h>
#include <string.h>

LOG_MODULE_REGISTER(embenet_middleware, CONFIG_EMBENET_LOG_LEVEL);

BUILD_ASSERT(sizeof(((EMBENET_NODE_JoinConfig *)0)->k1.val) == EMBENET_KEY_SIZE, "K1 size mismatch");
BUILD_ASSERT(sizeof(((EMBENET_NODE_JoinConfig *)0)->psk.val) == EMBENET_KEY_SIZE, "PSK size mismatch");
BUILD_ASSERT((int)EMBENET_NEIGHBOR_ROLE_PARENT == (int)EMBENET_NODE_DIAG_NEIGHBOR_ROLE_PARENT &&
                 (int)EMBENET_NEIGHBOR_ROLE_CHILD == (int)EMBENET_NODE_DIAG_NEIGHBOR_ROLE_CHILD &&
                 (int)EMBENET_NEIGHBOR_ROLE_UNRELATED == (int)EMBENET_NODE_DIAG_NEIGHBOR_ROLE_UNRELATED,
             "neighbor roles must map one to one");
BUILD_ASSERT(sizeof(CONFIG_EMBENET_SETTINGS_DEFAULT_K1) - 1U == 2U * EMBENET_KEY_SIZE, "CONFIG_EMBENET_SETTINGS_DEFAULT_K1 must be 32 hex digits");
BUILD_ASSERT(sizeof(CONFIG_EMBENET_SETTINGS_DEFAULT_PSK) - 1U == 2U * EMBENET_KEY_SIZE, "CONFIG_EMBENET_SETTINGS_DEFAULT_PSK must be 32 hex digits");

/// The configuration the stack runs with, as the settings hold it.
typedef struct {
  uint8_t k1[EMBENET_KEY_SIZE];
  uint8_t psk[EMBENET_KEY_SIZE];
  bool active;
} embenet_config_t;

/// How long the stopped stack waits for a configuration change between checks.
#define IDLE_POLL_MS 100
/// How long the running stack sleeps when no port interrupt wakes it.
#define PROC_POLL_MS 5
/// Pause before retrying a stack that failed to start.
#define START_RETRY_MS 1000
/// Priority of the embeNET thread. It sleeps until a port interrupt has work for it, so a high priority costs little
/// and keeps the stack responsive.
#define THREAD_PRIORITY 0
/// A change of K1, PSK or the active switch restarts the stack once no further change has come for this long, so a
/// provisioning tool writing K1 and PSK one after the other causes one restart, not two.
#define SETTINGS_APPLY_DELAY_MS 1500
/// Longest wait for the network to be left before the stack is stopped. A joined node leaves gently, which takes it
/// about 4 s; the stack is stopped after this long even if it has not reported leaving.
#define LEAVE_TIMEOUT_MS 6000

/// Guards everything below and every call into the stack. Recursive: stack callbacks run inside EMBENET_NODE_Proc(),
/// which already holds it, and may call the getters.
static K_MUTEX_DEFINE(mtx);
/// Given once by embenet_init() to let the embeNET thread run.
static K_SEM_DEFINE(start_sem, 0, 1);
/// Given by the settings handler to wake the stopped stack's thread.
static K_SEM_DEFINE(config_sem, 0, 1);

static bool init_called;
static embenet_cb_t callbacks;

/// Configuration as the settings hold it, applied by the embeNET thread once it has settled.
static embenet_config_t config;
/// true once @ref config holds the Kconfig defaults, before any setting overrides them.
static bool config_defaulted;
/// true from a change until the embeNET thread takes it over.
static bool config_pending;
/// Uptime of the last change, in ms.
static int64_t config_changed_ms;

/// true between EMBENET_NODE_Init() and EMBENET_NODE_Deinit(); the stack's getters abort outside it.
static bool stack_initialized;
static bool joined;
/// Set when the stack reports leaving; ends the wait in stop_stack().
static bool left;

/// Raises @p event to the application. Called with @ref mtx held.
static void notify(embenet_event_t event) {
  if(NULL != callbacks.event_cb) {
    callbacks.event_cb(callbacks.cb_ctx, event);
  }
}

static bool config_equal(embenet_config_t const *a, embenet_config_t const *b) {
  return (a->active == b->active) && (0 == memcmp(a->k1, b->k1, EMBENET_KEY_SIZE)) && (0 == memcmp(a->psk, b->psk, EMBENET_KEY_SIZE));
}

/// Records a change. Called with @ref mtx held.
static void config_changed(void) {
  config_pending = true;
  config_changed_ms = k_uptime_get();
  k_sem_give(&config_sem);
}

/// Fills @ref config with the Kconfig defaults, once. Called with @ref mtx held.
static void config_default(void) {
  if(config_defaulted) {
    return;
  }
  size_t const k1 = hex2bin(CONFIG_EMBENET_SETTINGS_DEFAULT_K1, 2U * EMBENET_KEY_SIZE, config.k1, EMBENET_KEY_SIZE);
  size_t const psk = hex2bin(CONFIG_EMBENET_SETTINGS_DEFAULT_PSK, 2U * EMBENET_KEY_SIZE, config.psk, EMBENET_KEY_SIZE);
  __ASSERT(EMBENET_KEY_SIZE == k1 && EMBENET_KEY_SIZE == psk, "the default K1 and PSK must be hex digits");
  ARG_UNUSED(k1);
  ARG_UNUSED(psk);
  config.active = IS_ENABLED(CONFIG_EMBENET_SETTINGS_DEFAULT_ACTIVE);
  config_defaulted = true;
}

// ----- settings handler for EMBENET_SETTINGS_SUBTREE -----

/**
 * Takes a value from the settings: at settings_load() for what is stored, at settings_runtime_set() for a change.
 * Called in the caller's thread.
 *
 * @param name    Key below EMBENET_SETTINGS_SUBTREE.
 * @param len     Size of the value.
 * @param read_cb Reads the value.
 * @param cb_arg  Argument for @p read_cb.
 * @return 0, -ENOENT for an unknown key, -EINVAL for a value of the wrong size or range.
 */
static int settings_set(char const *name, size_t len, settings_read_cb read_cb, void *cb_arg) {
  bool const is_k1 = settings_name_steq(name, "k1", NULL);
  bool const is_psk = settings_name_steq(name, "psk", NULL);
  bool const is_active = settings_name_steq(name, "active", NULL);
  if(!is_k1 && !is_psk && !is_active) {
    return -ENOENT;
  }

  uint8_t value[EMBENET_KEY_SIZE];
  size_t const size = is_active ? 1U : EMBENET_KEY_SIZE;
  if(len != size) {
    LOG_WRN("setting " EMBENET_SETTINGS_SUBTREE "/%s has %zu bytes, expected %zu - ignored", name, len, size);
    return -EINVAL;
  }
  ssize_t const read = read_cb(cb_arg, value, size);
  if(read != (ssize_t)size) {
    return (read < 0) ? (int)read : -EINVAL;
  }
  if(is_active && (value[0] > 1U)) {
    LOG_WRN("setting " EMBENET_SETTINGS_SUBTREE "/active is %u, expected 0 or 1 - ignored", value[0]);
    return -EINVAL;
  }

  k_mutex_lock(&mtx, K_FOREVER);
  config_default();
  bool changed;
  if(is_active) {
    changed = (config.active != (1U == value[0]));
    config.active = (1U == value[0]);
  } else {
    uint8_t *const key = is_k1 ? config.k1 : config.psk;
    changed = (0 != memcmp(key, value, EMBENET_KEY_SIZE));
    memcpy(key, value, EMBENET_KEY_SIZE);
  }
  if(changed) {
    config_changed();
  }
  k_mutex_unlock(&mtx);

  if(changed) {
    // Only the first byte of a key: enough to tell configurations apart in a log, not enough to give them away.
    LOG_INF("setting " EMBENET_SETTINGS_SUBTREE "/%s now %02x%s", name, value[0], is_active ? "" : "..");
  }
  return 0;
}

/**
 * Gives a value to settings_runtime_get().
 *
 * @param name        Key below EMBENET_SETTINGS_SUBTREE.
 * @param val         Buffer for the value.
 * @param val_len_max Size of @p val.
 * @return Size of the value, -ENOENT for an unknown key, -EINVAL if @p val is too small.
 */
static int settings_get(char const *name, char *val, int val_len_max) {
  uint8_t value[EMBENET_KEY_SIZE];
  int size;

  k_mutex_lock(&mtx, K_FOREVER);
  config_default();
  if(settings_name_steq(name, "k1", NULL)) {
    memcpy(value, config.k1, EMBENET_KEY_SIZE);
    size = EMBENET_KEY_SIZE;
  } else if(settings_name_steq(name, "psk", NULL)) {
    memcpy(value, config.psk, EMBENET_KEY_SIZE);
    size = EMBENET_KEY_SIZE;
  } else if(settings_name_steq(name, "active", NULL)) {
    value[0] = config.active ? 1U : 0U;
    size = 1;
  } else {
    size = -ENOENT;
  }
  k_mutex_unlock(&mtx);

  if(size < 0) {
    return size;
  }
  if(val_len_max < size) {
    return -EINVAL;
  }
  memcpy(val, value, (size_t)size);
  return size;
}

SETTINGS_STATIC_HANDLER_DEFINE(embenet_middleware, EMBENET_SETTINGS_SUBTREE, settings_get, settings_set, NULL, NULL);

// ----- stack callbacks, called from EMBENET_NODE_Proc() with mtx held -----

static void on_joined(EMBENET_PANID pan_id, EMBENET_NODE_QuickJoinCredentials const *quick_join_credentials) {
  ARG_UNUSED(quick_join_credentials);
  LOG_INF("joined network 0x%04" PRIx16, pan_id);
  joined = true;
  notify(EMBENET_EVENT_JOINED);
}

static void on_left(void) {
  LOG_WRN("left the network");
  joined = false;
  left = true;
  notify(EMBENET_EVENT_LEFT);
}

static void on_join_attempt(EMBENET_PANID pan_id, uint8_t const *pan_data, size_t pan_data_size) {
  ARG_UNUSED(pan_data);
  LOG_INF("synchronized to network 0x%04" PRIx16 " (%zu bytes of PAN data), joining", pan_id, pan_data_size);
}

static void on_data_on_unregistered_port(uint16_t port) { LOG_DBG("datagram on unregistered port %" PRIu16, port); }

// ----- embeNET thread -----

/// Sleeps until a port interrupt has work for the stack, or @p timeout, then runs it.
static void proc(k_timeout_t timeout) {
  (void)k_sem_take(EMBENET_PORT_COMMON_GetProcSemaphore(), timeout);
  k_mutex_lock(&mtx, K_FOREVER);
  EMBENET_NODE_Proc();
  if(NULL != callbacks.proc_cb) {
    callbacks.proc_cb(callbacks.cb_ctx);
  }
  k_mutex_unlock(&mtx);
}

/**
 * Takes over a settled configuration change.
 *
 * @param[in,out] in_force Configuration the stack runs with; replaced when a settled change differs from it.
 * @return true if @p in_force was replaced.
 */
static bool take_config_change(embenet_config_t *in_force) {
  bool replaced = false;
  k_mutex_lock(&mtx, K_FOREVER);
  if(config_pending && (k_uptime_get() - config_changed_ms >= SETTINGS_APPLY_DELAY_MS)) {
    config_pending = false;
    if(!config_equal(in_force, &config)) {
      *in_force = config;
      replaced = true;
    }
  }
  k_mutex_unlock(&mtx);
  return replaced;
}

/**
 * Initializes the stack and starts joining with @p cfg.
 * @return true if the stack runs.
 */
static bool start_stack(embenet_config_t const *cfg) {
  EMBENET_NODE_EventHandlers const handlers = {
      .onJoined = on_joined,
      .onLeft = on_left,
      .onJoinAttempt = on_join_attempt,
      .onQuickJoinCredentialsObsolete = NULL,
      .onDataOnUnregisteredPort = on_data_on_unregistered_port,
  };

  k_mutex_lock(&mtx, K_FOREVER);

  EMBENET_Result result = EMBENET_NODE_Init(&handlers, EMBENET_NODE_GetConfig_2400_2480Mhz_BLE_PHY());
  if(EMBENET_RESULT_OK != result) {
    k_mutex_unlock(&mtx);
    LOG_ERR("EMBENET_NODE_Init() failed: %d", (int)result);
    return false;
  }
  stack_initialized = true;
  joined = false;
  notify(EMBENET_EVENT_INITIALIZED);

  EMBENET_NODE_JoinConfig join_config;
  memcpy(join_config.k1.val, cfg->k1, EMBENET_KEY_SIZE);
  memcpy(join_config.psk.val, cfg->psk, EMBENET_KEY_SIZE);
  result = EMBENET_NODE_Join(&join_config);
  if(EMBENET_RESULT_OK != result) {
    EMBENET_NODE_Deinit();
    stack_initialized = false;
    notify(EMBENET_EVENT_DEINITIALIZED);
    k_mutex_unlock(&mtx);
    LOG_ERR("EMBENET_NODE_Join() failed: %d", (int)result);
    return false;
  }

  k_mutex_unlock(&mtx);

  // Only the first byte of each key: enough to tell configurations apart in a log, not enough to give them away.
  LOG_INF("started, EUI-64 %016" PRIx64 ", joining with K1 %02x.. PSK %02x..", embenet_get_eui64(), cfg->k1[0], cfg->psk[0]);
  return true;
}

/// Leaves the network gently, if in one, and stops the stack.
static void stop_stack(void) {
  LOG_INF("stopping");

  k_mutex_lock(&mtx, K_FOREVER);
  left = false;
  // Only a joined node has a network to tell; the stack reports leaving only then, so waiting otherwise would only run
  // out the timeout.
  bool const leaving = joined && (EMBENET_RESULT_OK == EMBENET_NODE_Leave());
  k_mutex_unlock(&mtx);

  if(leaving) {
    int64_t const deadline = k_uptime_get() + LEAVE_TIMEOUT_MS;
    // left is written only by on_left(), which runs in proc() on this same thread.
    while(!left && (k_uptime_get() < deadline)) {
      proc(K_MSEC(PROC_POLL_MS));
    }
  }

  k_mutex_lock(&mtx, K_FOREVER);
  if(joined) {
    joined = false;
    notify(EMBENET_EVENT_LEFT);
  }
  EMBENET_NODE_Deinit();
  stack_initialized = false;
  notify(EMBENET_EVENT_DEINITIALIZED);
  k_mutex_unlock(&mtx);

  LOG_INF("stopped");
}

static void embenet_thread_main(void *p1, void *p2, void *p3) {
  ARG_UNUSED(p1);
  ARG_UNUSED(p2);
  ARG_UNUSED(p3);

  (void)k_sem_take(&start_sem, K_FOREVER);

  embenet_config_t in_force;
  k_mutex_lock(&mtx, K_FOREVER);
  in_force = config;
  k_mutex_unlock(&mtx);

  for(;;) {
    if(in_force.active && start_stack(&in_force)) {
      while(!take_config_change(&in_force)) {
        proc(K_MSEC(PROC_POLL_MS));
      }
      stop_stack();
      continue;
    }

    // Stopped - by configuration, or because the stack failed to start, in which case it is retried after a pause.
    if(!in_force.active) {
      LOG_INF("inactive, the radio is left to other protocols");
    }
    int64_t const retry_at = k_uptime_get() + START_RETRY_MS;
    bool replaced = false;
    while(!replaced && !(in_force.active && (k_uptime_get() >= retry_at))) {
      (void)k_sem_take(&config_sem, K_MSEC(IDLE_POLL_MS));
      replaced = take_config_change(&in_force);
    }
  }
}

K_THREAD_DEFINE(embenet_thread, CONFIG_EMBENET_MIDDLEWARE_THREAD_STACK_SIZE, embenet_thread_main, NULL, NULL, NULL, THREAD_PRIORITY, K_FP_REGS, 0);

// ----- API -----

int embenet_init(embenet_cb_t cb) {
  k_mutex_lock(&mtx, K_FOREVER);
  if(init_called) {
    k_mutex_unlock(&mtx);
    return -EALREADY;
  }
  init_called = true;
  callbacks = cb;
  config_default();
  k_mutex_unlock(&mtx);

  // Outside the lock: the settings subsystem calls back into settings_set(), which takes it.
  int err = settings_subsys_init();
  if(0 == err) {
    err = settings_load_subtree(EMBENET_SETTINGS_SUBTREE);
  }
  if(0 != err) {
    LOG_ERR("settings unavailable (%d), running with the Kconfig defaults", err);
  }

  k_mutex_lock(&mtx, K_FOREVER);
  // What was loaded is the starting configuration, not a change to apply.
  config_pending = false;
  bool const active = config.active;
  k_mutex_unlock(&mtx);

  LOG_INF("embeNET Node %s, %s", EMBENET_NODE_GetVersionString(), active ? "active" : "inactive");
  k_sem_give(&start_sem);
  return 0;
}

bool embenet_is_joined(void) {
  k_mutex_lock(&mtx, K_FOREVER);
  bool const r = joined;
  k_mutex_unlock(&mtx);
  return r;
}

uint64_t embenet_get_eui64(void) {
  k_mutex_lock(&mtx, K_FOREVER);
  // The stack's UID once it runs; until then the hardware identity the stack takes it from.
  uint64_t const eui = stack_initialized ? EMBENET_NODE_GetUID() : EMBENET_EUI64_Get();
  k_mutex_unlock(&mtx);
  return eui;
}

char const *embenet_get_stack_version_string(void) { return EMBENET_NODE_GetVersionString(); }

size_t embenet_get_groups(uint16_t *groups, size_t max_count) {
  __ASSERT_NO_MSG((NULL != groups) || (0U == max_count));
  size_t count = 0;
  k_mutex_lock(&mtx, K_FOREVER);
  if(stack_initialized) {
    count = MIN(EMBENET_NODE_GetGroupCount(), max_count);
    for(size_t i = 0; i < count; ++i) {
      groups[i] = EMBENET_NODE_GetGroupByIndex(i);
    }
  }
  k_mutex_unlock(&mtx);
  return count;
}

uint16_t embenet_get_neighbors_count(void) {
  unsigned count = 0;
  k_mutex_lock(&mtx, K_FOREVER);
  if(stack_initialized) {
    count = EMBENET_NODE_DIAG_GetNeighborCount();
  }
  k_mutex_unlock(&mtx);
  return (uint16_t)MIN(count, UINT16_MAX);
}

bool embenet_get_neighbor(size_t index, embenet_neighbor_t *neighbor) {
  __ASSERT_NO_MSG(NULL != neighbor);
  bool found = false;
  k_mutex_lock(&mtx, K_FOREVER);
  // The stack numbers the neighbors it tracks 0 .. GetNeighborCount() - 1 and answers EUI 0 outside that range.
  if(stack_initialized && (index < EMBENET_NODE_DIAG_GetNeighborCount())) {
    EMBENET_NODE_DIAG_NeighborInfo const info = EMBENET_NODE_DIAG_GetNeighborInfo((unsigned)index);
    if(0U != info.eui) {
      *neighbor = (embenet_neighbor_t){.eui = info.eui, .rssi = info.rssi, .role = (embenet_neighbor_role_t)info.role};
      found = true;
    }
  }
  k_mutex_unlock(&mtx);
  return found;
}

uint64_t embenet_get_parent_eui64(void) {
  uint64_t eui = 0;
  k_mutex_lock(&mtx, K_FOREVER);
  if(stack_initialized && joined) {
    eui = EMBENET_NODE_DIAG_GetParentEUI64();
  }
  k_mutex_unlock(&mtx);
  return eui;
}

int8_t embenet_get_parent_rssi(void) {
  int8_t rssi = EMBENET_RSSI_UNAVAILABLE;
  k_mutex_lock(&mtx, K_FOREVER);
  // The stack answers INT8_MIN when not joined and INT8_MAX when the RSSI is unknown; one marker covers both.
  if(stack_initialized && joined && (0U != EMBENET_NODE_DIAG_GetParentEUI64())) {
    int8_t const r = EMBENET_NODE_DIAG_GetParentRSSI();
    rssi = (INT8_MIN == r) ? EMBENET_RSSI_UNAVAILABLE : r;
  }
  k_mutex_unlock(&mtx);
  return rssi;
}

uint16_t embenet_get_radio_duty_cycle(void) {
  uint32_t duty_cycle = 0;
  k_mutex_lock(&mtx, K_FOREVER);
  if(stack_initialized) {
    // The three states are exclusive, so their shares add up to the time the radio is on.
    duty_cycle =
        (uint32_t)EMBENET_NODE_DIAG_GetRadioReadyDutyCycle() + EMBENET_NODE_DIAG_GetRadioTxDutyCycle() + EMBENET_NODE_DIAG_GetRadioRxDutyCycle();
  }
  k_mutex_unlock(&mtx);
  return (uint16_t)MIN(duty_cycle, 10000U);
}
```

## src/embenet.h
```c
/**
 * @file
 * @license   Apache-2.0
 * @copyright Embetech sp. z o.o.
 * @version   2.0.0
 * @brief     embeNET middleware API - runs the Node stack and gives the application thread-safe access to it.
 *
 * The middleware owns the stack. It initializes it, joins the network with the configured credentials, keeps calling
 * EMBENET_NODE_Proc() from a thread of its own, and restarts the stack when the credentials or the active switch
 * change. The application talks to it through this header only.
 *
 * @par Configuration in Zephyr settings
 * K1, the PSK and the active switch live in Zephyr settings, under @ref EMBENET_SETTINGS_SUBTREE, and so in the
 * device's non-volatile memory. The middleware reads them through a settings handler: embenet_init() loads them, and
 * the handler sees every later change made through settings_runtime_set() or settings_load(). To change one, save it
 * with settings_save_one() and hand it over with settings_runtime_set(), as the Bluetooth Provisioning service does.
 * Keys never stored take their Kconfig defaults (CONFIG_EMBENET_SETTINGS_DEFAULT_*).
 *
 * @note All functions are thread safe. Every call into the stack, from the embeNET thread or from these functions,
 *       happens under one module mutex.
 *
 * @par Callbacks and the raw stack API
 * @ref embenet_event_cb_t runs on the embeNET thread with the module mutex held, and so do the stack's own callbacks
 * (UDP receive handlers, tasks created with EMBENET_NODE_TaskCreate()). Inside them the raw EMBENET_NODE_* API may
 * be called directly - that is where an application registers its sockets, joins groups and schedules its tasks.
 * Outside them, use only this header. Callbacks must not block: a thread waiting on them may hold the Bluetooth stack
 * or the application waiting for this module's mutex.
 */
#ifndef EMBENET_H_
#define EMBENET_H_

#include <stdbool.h>
#include <stddef.h>
#include <stdint.h>

#ifdef __cplusplus
extern "C" {
#endif

/// Size of K1 and of the PSK, in bytes.
#define EMBENET_KEY_SIZE 16U

/// Parent RSSI and neighbor RSSI when no value is available.
#define EMBENET_RSSI_UNAVAILABLE INT8_MAX

/// @name Zephyr settings the middleware takes its configuration from
/// @{
/// Subtree of all embeNET settings.
#define EMBENET_SETTINGS_SUBTREE "embenet"
/// Network key, @ref EMBENET_KEY_SIZE bytes: the same on every device of the network.
#define EMBENET_SETTINGS_KEY_K1 EMBENET_SETTINGS_SUBTREE "/k1"
/// Pre-shared key, @ref EMBENET_KEY_SIZE bytes: what the border router's join rule admits this node with.
#define EMBENET_SETTINGS_KEY_PSK EMBENET_SETTINGS_SUBTREE "/psk"
/// Active switch, 1 byte: 1 the stack runs and joins the network; 0 the stack is stopped and the radio left to others.
#define EMBENET_SETTINGS_KEY_ACTIVE EMBENET_SETTINGS_SUBTREE "/active"
/// @}

/// Role of a neighbor relative to this node.
typedef enum {
  EMBENET_NEIGHBOR_ROLE_PARENT = 0,    ///< This node's parent.
  EMBENET_NEIGHBOR_ROLE_CHILD = 1,     ///< A child of this node.
  EMBENET_NEIGHBOR_ROLE_UNRELATED = 2, ///< Heard, but not routed through.
} embenet_neighbor_role_t;

/// One neighbor of this node.
typedef struct {
  uint64_t eui;                 ///< Neighbor's EUI-64.
  int8_t rssi;                  ///< RSSI of the last frame from it, in dBm; @ref EMBENET_RSSI_UNAVAILABLE if not known.
  embenet_neighbor_role_t role; ///< @ref embenet_neighbor_role_t
} embenet_neighbor_t;

/// embeNET events, see @ref embenet_event_cb_t.
typedef enum {
  EMBENET_EVENT_INITIALIZED,   ///< Stack initialized, about to join: register sockets, join groups, create tasks now.
  EMBENET_EVENT_JOINED,        ///< Joined the network.
  EMBENET_EVENT_LEFT,          ///< Left the network.
  EMBENET_EVENT_DEINITIALIZED, ///< Stack stopped; sockets, groups and tasks are gone with it.
} embenet_event_t;

/**
 * embeNET event callback.
 *
 * @param ctx   @ref embenet_cb_t::cb_ctx
 * @param event @ref embenet_event_t
 *
 * @note Called from the embeNET thread with the module mutex held - see the file description. Must not block.
 */
typedef void (*embenet_event_cb_t)(void *ctx, embenet_event_t event);

/**
 * Called after every EMBENET_NODE_Proc(), so the application can poll its own work on the stack's thread: at least
 * every few milliseconds while the stack runs, never while it is stopped.
 *
 * @param ctx @ref embenet_cb_t::cb_ctx
 *
 * @note Called from the embeNET thread with the module mutex held, like @ref embenet_event_cb_t. Must not block.
 */
typedef void (*embenet_proc_cb_t)(void *ctx);

/// Callbacks installed by @ref embenet_init.
typedef struct {
  embenet_event_cb_t event_cb; ///< @ref embenet_event_cb_t, may be NULL
  embenet_proc_cb_t proc_cb;   ///< @ref embenet_proc_cb_t, may be NULL
  void *cb_ctx;                ///< Context passed to every callback.
} embenet_cb_t;

/**
 * Installs the callbacks, loads the configuration from Zephyr settings (initializing the settings subsystem if needed)
 * and starts the embeNET thread, which starts the stack if the configuration says it is active.
 *
 * Every later change of an @ref EMBENET_SETTINGS_SUBTREE key that reaches the settings handler takes effect, restarting
 * the stack, 1.5 s after the last change (@c SETTINGS_APPLY_DELAY_MS in embenet.c). Switching off leaves the network
 * gently, which takes a few seconds, then stops the stack and frees the radio.
 *
 * @param cb Callbacks.
 *
 * @retval 0         started; if the settings could not be loaded, with the Kconfig defaults
 * @retval -EALREADY called before
 */
int embenet_init(embenet_cb_t cb);

/**
 * @return true while joined to a network.
 */
bool embenet_is_joined(void);

/**
 * @return This node's EUI-64. Available whether or not the stack runs.
 */
uint64_t embenet_get_eui64(void);

/**
 * @return The stack's version, a NUL-terminated UTF-8 string with static storage.
 */
char const *embenet_get_stack_version_string(void);

/**
 * Copies the multicast groups this node belongs to.
 *
 * @param[out] groups    Buffer for @p max_count group ids.
 * @param      max_count Capacity of @p groups.
 * @return Number of groups copied; 0 when the stack is stopped.
 */
size_t embenet_get_groups(uint16_t *groups, size_t max_count);

/**
 * @return Number of neighbors the node tracks; 0 when the stack is stopped.
 */
uint16_t embenet_get_neighbors_count(void);

/**
 * Copies one entry of the neighbor table.
 *
 * @param      index    Order number of the neighbor, 0 .. @ref embenet_get_neighbors_count() - 1. The table changes as
 *                      the node hears its neighbors, so an index valid a moment ago may not be any more.
 * @param[out] neighbor Not NULL; written only on success.
 * @return true if @p index named a neighbor; false if it is out of range or the stack is stopped.
 */
bool embenet_get_neighbor(size_t index, embenet_neighbor_t *neighbor);

/**
 * @return The parent's EUI-64; 0 when the node has no parent (not joined, or the root).
 */
uint64_t embenet_get_parent_eui64(void);

/**
 * @return RSSI of the last frame from the parent, in dBm; @ref EMBENET_RSSI_UNAVAILABLE when there is no parent.
 */
int8_t embenet_get_parent_rssi(void);

/**
 * @return Share of time the radio is on (ready, receiving or transmitting) since the stack started, in 0.01% units
 *         (0..10000); 0 when the stack is stopped.
 */
uint16_t embenet_get_radio_duty_cycle(void);

#ifdef __cplusplus
}
#endif

#endif // EMBENET_H_
```

## src/embenet_ble.c
```c
/**
 * @file
 * @license   Apache-2.0
 * @copyright Embetech sp. z o.o.
 * @version   2.0.0
 * @purpose   embeNET Bluetooth LE peripheral
 * @brief     Advertising and connection handling for the embeNET GATT services.
 *
 * The advertisement carries the Provisioning service UUID, which is what a central filters on to find embeNET nodes.
 * A 128-bit UUID and the name do not fit in one 31-byte advertisement together, so the name goes in the scan response.
 */

#include "embenet_ble.h"

#include <zephyr/bluetooth/bluetooth.h>
#include <zephyr/bluetooth/conn.h>
#include <zephyr/bluetooth/gap.h>
#include <zephyr/kernel.h>
#include <zephyr/logging/log.h>

#include <errno.h>
#include <inttypes.h>

LOG_MODULE_REGISTER(embenet_ble, CONFIG_EMBENET_LOG_LEVEL);

BUILD_ASSERT(CONFIG_EMBENET_BLE_ADV_INTERVAL_MIN_MS <= CONFIG_EMBENET_BLE_ADV_INTERVAL_MAX_MS, "advertising interval range is inverted");

#if defined(CONFIG_BT_GAP_PERIPHERAL_PREF_PARAMS)
// The rule bt_le_conn_params_valid() applies before sending the connection parameter update request, in the units
// Kconfig uses (1.25 ms intervals, 10 ms timeout). Broken, the request is never sent and nothing says so.
BUILD_ASSERT(4 * CONFIG_BT_PERIPHERAL_PREF_TIMEOUT > (1 + CONFIG_BT_PERIPHERAL_PREF_LATENCY) * CONFIG_BT_PERIPHERAL_PREF_MAX_INT,
             "supervision timeout must exceed (1 + latency) x max interval x 2");
#endif

static struct bt_data const advertisement[] = {
    BT_DATA_BYTES(BT_DATA_FLAGS, (BT_LE_AD_GENERAL | BT_LE_AD_NO_BREDR)),
    BT_DATA_BYTES(BT_DATA_UUID128_ALL, EMBENET_BLE_UUID_PROVISIONING_SERVICE_VAL),
};

static struct bt_data const scan_response[] = {
    BT_DATA(BT_DATA_NAME_COMPLETE, CONFIG_BT_DEVICE_NAME, sizeof(CONFIG_BT_DEVICE_NAME) - 1U),
};

static struct bt_le_adv_param const advertising_parameters =
    BT_LE_ADV_PARAM_INIT(BT_LE_ADV_OPT_CONN, BT_GAP_MS_TO_ADV_INTERVAL(CONFIG_EMBENET_BLE_ADV_INTERVAL_MIN_MS),
                         BT_GAP_MS_TO_ADV_INTERVAL(CONFIG_EMBENET_BLE_ADV_INTERVAL_MAX_MS), NULL);

static int start_advertising(void) {
  int const err = bt_le_adv_start(&advertising_parameters, advertisement, ARRAY_SIZE(advertisement), scan_response, ARRAY_SIZE(scan_response));
  if((0 != err) && (-EALREADY != err)) {
    LOG_ERR("bt_le_adv_start() failed: %d", err);
    return err;
  }
  LOG_INF("advertising as \"%s\"", CONFIG_BT_DEVICE_NAME);
  return 0;
}

static void restart_advertising(struct k_work *work) {
  ARG_UNUSED(work);
  (void)start_advertising();
}

/// Connectable advertising stops when a central connects. It is restarted once the connection object is recycled -
/// before that the controller may have no room for a new connection - and from a work item, off the Bluetooth thread.
static K_WORK_DEFINE(advertising_restart, restart_advertising);

static void on_connected(struct bt_conn *conn, uint8_t err) {
  if(0U != err) {
    LOG_WRN("connection failed: 0x%02x", err);
    return;
  }
  // The interval is what the mesh has to fit its timeslots around, so it is worth knowing.
  struct bt_conn_info info;
  if(0 == bt_conn_get_info(conn, &info)) {
    LOG_INF("central connected, interval %" PRIu32 " us", info.le.interval_us);
  }
}

static void on_disconnected(struct bt_conn *conn, uint8_t reason) {
  ARG_UNUSED(conn);
  LOG_INF("central disconnected: 0x%02x", reason);
}

static void on_recycled(void) { k_work_submit(&advertising_restart); }

static void on_le_param_updated(struct bt_conn *conn, uint16_t interval, uint16_t latency, uint16_t timeout) {
  ARG_UNUSED(conn);
  LOG_INF("connection interval now %u us, latency %u, timeout %u ms", BT_CONN_INTERVAL_TO_US(interval), latency, timeout * 10U);
}

BT_CONN_CB_DEFINE(embenet_ble_conn_callbacks) = {
    .connected = on_connected,
    .disconnected = on_disconnected,
    .recycled = on_recycled,
    .le_param_updated = on_le_param_updated,
};

int embenet_ble_start(void) {
  int const err = bt_enable(NULL);
  if((0 != err) && (-EALREADY != err)) {
    LOG_ERR("bt_enable() failed: %d", err);
    return err;
  }
  return start_advertising();
}
```

## src/embenet_ble.h
```c
/**
 * @file
 * @license   Apache-2.0
 * @copyright Embetech sp. z o.o.
 * @version   2.0.0
 * @brief     embeNET Bluetooth LE peripheral: advertising, and the Provisioning and Info GATT services.
 *
 * All UUIDs share one randomly generated vendor base, BAB8xxxx-E237-4BC2-80C7-3AC1568EF5A6, and differ in the 16-bit
 * field xxxx: a service takes a multiple of 0x0100 and its characteristics count up from it. The services and the
 * byte layout of every characteristic are described in README.md next to this file.
 */
#ifndef EMBENET_BLE_H_
#define EMBENET_BLE_H_

#include <zephyr/bluetooth/uuid.h>

#ifdef __cplusplus
extern "C" {
#endif

/// Encodes the 128-bit embeNET UUID with 16-bit field @p id, for BT_UUID_INIT_128() and BT_UUID_DECLARE_128().
#define EMBENET_BLE_UUID_ENCODE(id) BT_UUID_128_ENCODE(0xBAB80000U | (id), 0xE237, 0x4BC2, 0x80C7, 0x3AC1568EF5A6ULL)

/// @name embeNET Provisioning service
/// @{
#define EMBENET_BLE_UUID_PROVISIONING_SERVICE_VAL EMBENET_BLE_UUID_ENCODE(0x0100)
#define EMBENET_BLE_UUID_PROVISIONING_K1_VAL EMBENET_BLE_UUID_ENCODE(0x0101)
#define EMBENET_BLE_UUID_PROVISIONING_PSK_VAL EMBENET_BLE_UUID_ENCODE(0x0102)
#define EMBENET_BLE_UUID_PROVISIONING_ACTIVE_VAL EMBENET_BLE_UUID_ENCODE(0x0103)
/// @}

/// @name embeNET Info service
/// @{
#define EMBENET_BLE_UUID_INFO_SERVICE_VAL EMBENET_BLE_UUID_ENCODE(0x0200)
#define EMBENET_BLE_UUID_INFO_EUI64_VAL EMBENET_BLE_UUID_ENCODE(0x0201)
#define EMBENET_BLE_UUID_INFO_STACK_VERSION_VAL EMBENET_BLE_UUID_ENCODE(0x0202)
#define EMBENET_BLE_UUID_INFO_GROUPS_VAL EMBENET_BLE_UUID_ENCODE(0x0203)
#define EMBENET_BLE_UUID_INFO_NEIGHBORS_COUNT_VAL EMBENET_BLE_UUID_ENCODE(0x0204)
#define EMBENET_BLE_UUID_INFO_NEIGHBOR_SELECT_VAL EMBENET_BLE_UUID_ENCODE(0x0205)
#define EMBENET_BLE_UUID_INFO_NEIGHBOR_INFO_VAL EMBENET_BLE_UUID_ENCODE(0x0206)
#define EMBENET_BLE_UUID_INFO_PARENT_EUI64_VAL EMBENET_BLE_UUID_ENCODE(0x0207)
#define EMBENET_BLE_UUID_INFO_PARENT_RSSI_VAL EMBENET_BLE_UUID_ENCODE(0x0208)
#define EMBENET_BLE_UUID_INFO_DUTY_CYCLE_VAL EMBENET_BLE_UUID_ENCODE(0x0209)
#define EMBENET_BLE_UUID_INFO_CONNECTION_PARAMETERS_VAL EMBENET_BLE_UUID_ENCODE(0x020A)
/// @}

/**
 * Enables Bluetooth, if not already enabled, and starts connectable advertising of the Provisioning service UUID with
 * CONFIG_BT_DEVICE_NAME in the scan response. Advertising resumes by itself after a central disconnects.
 *
 * The services are registered statically; they serve requests as soon as Bluetooth is enabled, whether or not
 * embenet_init() has been called yet.
 *
 * @return 0 when advertising, a negative error code from bt_enable() or bt_le_adv_start() otherwise.
 *
 * @note Call from a thread: bt_enable() waits for the controller.
 */
int embenet_ble_start(void);

#ifdef __cplusplus
}
#endif

#endif // EMBENET_BLE_H_
```

## src/embenet_ble_info.c
```c
/**
 * @file
 * @license   Apache-2.0
 * @copyright Embetech sp. z o.o.
 * @version   2.0.0
 * @purpose   embeNET Bluetooth LE peripheral
 * @brief     embeNET Info GATT service: read-only view of the node's identity and place in the network.
 *
 * Every value comes from the middleware's getters at the time of the read and is little-endian on the air. Groups can
 * be longer than the ATT MTU allows and is then read in parts (Read Blob); the part at offset 0 takes a snapshot and the
 * following parts are served from it, so a long read never mixes two states of the list.
 *
 * Neighbors are read one at a time: a central writes the order number of a neighbor, 0 .. Neighbors Count - 1, to
 * Neighbor Select, then reads that neighbor's record from Neighbor Info. Each connection has a selection of its own,
 * 0 when it connects.
 */

#include "embenet.h"
#include "embenet_ble.h"

#include <zephyr/bluetooth/conn.h>
#include <zephyr/bluetooth/gatt.h>
#include <zephyr/bluetooth/uuid.h>
#include <zephyr/kernel.h>
#include <zephyr/sys/byteorder.h>

#include <string.h>

/// Bytes of the Neighbor Info characteristic: EUI-64, RSSI, role.
#define NEIGHBOR_RECORD_SIZE 10U

static struct bt_uuid_128 const service_uuid = BT_UUID_INIT_128(EMBENET_BLE_UUID_INFO_SERVICE_VAL);
static struct bt_uuid_128 const eui64_uuid = BT_UUID_INIT_128(EMBENET_BLE_UUID_INFO_EUI64_VAL);
static struct bt_uuid_128 const stack_version_uuid = BT_UUID_INIT_128(EMBENET_BLE_UUID_INFO_STACK_VERSION_VAL);
static struct bt_uuid_128 const groups_uuid = BT_UUID_INIT_128(EMBENET_BLE_UUID_INFO_GROUPS_VAL);
static struct bt_uuid_128 const neighbors_count_uuid = BT_UUID_INIT_128(EMBENET_BLE_UUID_INFO_NEIGHBORS_COUNT_VAL);
static struct bt_uuid_128 const neighbor_select_uuid = BT_UUID_INIT_128(EMBENET_BLE_UUID_INFO_NEIGHBOR_SELECT_VAL);
static struct bt_uuid_128 const neighbor_info_uuid = BT_UUID_INIT_128(EMBENET_BLE_UUID_INFO_NEIGHBOR_INFO_VAL);
static struct bt_uuid_128 const parent_eui64_uuid = BT_UUID_INIT_128(EMBENET_BLE_UUID_INFO_PARENT_EUI64_VAL);
static struct bt_uuid_128 const parent_rssi_uuid = BT_UUID_INIT_128(EMBENET_BLE_UUID_INFO_PARENT_RSSI_VAL);
static struct bt_uuid_128 const duty_cycle_uuid = BT_UUID_INIT_128(EMBENET_BLE_UUID_INFO_DUTY_CYCLE_VAL);
static struct bt_uuid_128 const connection_parameters_uuid = BT_UUID_INIT_128(EMBENET_BLE_UUID_INFO_CONNECTION_PARAMETERS_VAL);

/// Snapshot for long reads of Groups. GATT handlers all run on the Bluetooth RX thread, so the state here needs no lock.
static struct {
  uint8_t data[CONFIG_EMBENET_BLE_INFO_MAX_GROUPS * sizeof(uint16_t)];
  size_t size;
} groups_snapshot;

/// Neighbor Select, per connection.
static uint16_t neighbor_selected[CONFIG_BT_MAX_CONN];

static ssize_t read_u64(struct bt_conn *conn, struct bt_gatt_attr const *attr, void *buf, uint16_t len, uint16_t offset, uint64_t value) {
  uint8_t le[sizeof(uint64_t)];
  sys_put_le64(value, le);
  return bt_gatt_attr_read(conn, attr, buf, len, offset, le, sizeof(le));
}

static ssize_t read_u16(struct bt_conn *conn, struct bt_gatt_attr const *attr, void *buf, uint16_t len, uint16_t offset, uint16_t value) {
  uint8_t le[sizeof(uint16_t)];
  sys_put_le16(value, le);
  return bt_gatt_attr_read(conn, attr, buf, len, offset, le, sizeof(le));
}

static ssize_t read_eui64(struct bt_conn *conn, struct bt_gatt_attr const *attr, void *buf, uint16_t len, uint16_t offset) {
  return read_u64(conn, attr, buf, len, offset, embenet_get_eui64());
}

static ssize_t read_stack_version(struct bt_conn *conn, struct bt_gatt_attr const *attr, void *buf, uint16_t len, uint16_t offset) {
  char const *const version = embenet_get_stack_version_string();
  return bt_gatt_attr_read(conn, attr, buf, len, offset, version, strlen(version));
}

static ssize_t read_groups(struct bt_conn *conn, struct bt_gatt_attr const *attr, void *buf, uint16_t len, uint16_t offset) {
  if(0U == offset) {
    uint16_t groups[CONFIG_EMBENET_BLE_INFO_MAX_GROUPS];
    size_t const count = embenet_get_groups(groups, ARRAY_SIZE(groups));
    for(size_t i = 0; i < count; ++i) {
      sys_put_le16(groups[i], &groups_snapshot.data[i * sizeof(uint16_t)]);
    }
    groups_snapshot.size = count * sizeof(uint16_t);
  }
  return bt_gatt_attr_read(conn, attr, buf, len, offset, groups_snapshot.data, groups_snapshot.size);
}

static ssize_t read_neighbors_count(struct bt_conn *conn, struct bt_gatt_attr const *attr, void *buf, uint16_t len, uint16_t offset) {
  return read_u16(conn, attr, buf, len, offset, embenet_get_neighbors_count());
}

static ssize_t read_neighbor_select(struct bt_conn *conn, struct bt_gatt_attr const *attr, void *buf, uint16_t len, uint16_t offset) {
  return read_u16(conn, attr, buf, len, offset, neighbor_selected[bt_conn_index(conn)]);
}

static ssize_t write_neighbor_select(struct bt_conn *conn, struct bt_gatt_attr const *attr, void const *buf, uint16_t len, uint16_t offset,
                                     uint8_t flags) {
  ARG_UNUSED(attr);
  if(0U != (flags & BT_GATT_WRITE_FLAG_PREPARE)) {
    return BT_GATT_ERR(BT_ATT_ERR_ATTRIBUTE_NOT_LONG);
  }
  if(0U != offset) {
    return BT_GATT_ERR(BT_ATT_ERR_INVALID_OFFSET);
  }
  if(sizeof(uint16_t) != len) {
    return BT_GATT_ERR(BT_ATT_ERR_INVALID_ATTRIBUTE_LEN);
  }
  uint16_t const index = sys_get_le16(buf);
  if(index >= embenet_get_neighbors_count()) {
    return BT_GATT_ERR(BT_ATT_ERR_OUT_OF_RANGE);
  }
  neighbor_selected[bt_conn_index(conn)] = index;
  return len;
}

static ssize_t read_neighbor_info(struct bt_conn *conn, struct bt_gatt_attr const *attr, void *buf, uint16_t len, uint16_t offset) {
  embenet_neighbor_t neighbor;
  // The table may have shrunk since the selection was written, or the stack stopped.
  if(!embenet_get_neighbor(neighbor_selected[bt_conn_index(conn)], &neighbor)) {
    return BT_GATT_ERR(BT_ATT_ERR_OUT_OF_RANGE);
  }
  uint8_t record[NEIGHBOR_RECORD_SIZE];
  sys_put_le64(neighbor.eui, &record[0]);
  record[8] = (uint8_t)neighbor.rssi;
  record[9] = (uint8_t)neighbor.role;
  return bt_gatt_attr_read(conn, attr, buf, len, offset, record, sizeof(record));
}

static ssize_t read_parent_eui64(struct bt_conn *conn, struct bt_gatt_attr const *attr, void *buf, uint16_t len, uint16_t offset) {
  return read_u64(conn, attr, buf, len, offset, embenet_get_parent_eui64());
}

static ssize_t read_parent_rssi(struct bt_conn *conn, struct bt_gatt_attr const *attr, void *buf, uint16_t len, uint16_t offset) {
  int8_t const rssi = embenet_get_parent_rssi();
  return bt_gatt_attr_read(conn, attr, buf, len, offset, &rssi, sizeof(rssi));
}

static ssize_t read_duty_cycle(struct bt_conn *conn, struct bt_gatt_attr const *attr, void *buf, uint16_t len, uint16_t offset) {
  return read_u16(conn, attr, buf, len, offset, embenet_get_radio_duty_cycle());
}

/// The parameters of the connection the read arrives on - what a central cannot learn from its own Bluetooth stack
/// without privileges. 8 bytes: interval in us (uint32), peripheral latency in events (uint16), supervision timeout in
/// 10 ms units (uint16).
static ssize_t read_connection_parameters(struct bt_conn *conn, struct bt_gatt_attr const *attr, void *buf, uint16_t len, uint16_t offset) {
  struct bt_conn_info info;
  if(0 != bt_conn_get_info(conn, &info)) {
    return BT_GATT_ERR(BT_ATT_ERR_UNLIKELY);
  }
  uint8_t value[8];
  sys_put_le32(info.le.interval_us, &value[0]);
  sys_put_le16(info.le.latency, &value[4]);
  sys_put_le16(info.le.timeout, &value[6]);
  return bt_gatt_attr_read(conn, attr, buf, len, offset, value, sizeof(value));
}

static void on_connected(struct bt_conn *conn, uint8_t err) {
  if(0U == err) {
    neighbor_selected[bt_conn_index(conn)] = 0U;
  }
}

BT_CONN_CB_DEFINE(embenet_ble_info_conn_callbacks) = {
    .connected = on_connected,
};

#define INFO_CHARACTERISTIC(uuid128, read) BT_GATT_CHARACTERISTIC(&(uuid128).uuid, BT_GATT_CHRC_READ, BT_GATT_PERM_READ, read, NULL, NULL)

BT_GATT_SERVICE_DEFINE(embenet_ble_info_service, BT_GATT_PRIMARY_SERVICE(&service_uuid), INFO_CHARACTERISTIC(eui64_uuid, read_eui64),
                       INFO_CHARACTERISTIC(stack_version_uuid, read_stack_version), INFO_CHARACTERISTIC(groups_uuid, read_groups),
                       INFO_CHARACTERISTIC(neighbors_count_uuid, read_neighbors_count),
                       BT_GATT_CHARACTERISTIC(&neighbor_select_uuid.uuid, BT_GATT_CHRC_READ | BT_GATT_CHRC_WRITE,
                                              BT_GATT_PERM_READ | BT_GATT_PERM_WRITE, read_neighbor_select, write_neighbor_select, NULL),
                       INFO_CHARACTERISTIC(neighbor_info_uuid, read_neighbor_info), INFO_CHARACTERISTIC(parent_eui64_uuid, read_parent_eui64),
                       INFO_CHARACTERISTIC(parent_rssi_uuid, read_parent_rssi), INFO_CHARACTERISTIC(duty_cycle_uuid, read_duty_cycle),
                       INFO_CHARACTERISTIC(connection_parameters_uuid, read_connection_parameters));
```
